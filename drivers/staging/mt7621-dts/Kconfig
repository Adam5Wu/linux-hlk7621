## drivers/staging/mt7621-dts/Kconfig
```kconfig
# SPDX-License-Identifier: GPL-2.0
config DTB_GNUBEE1
	bool "GnuBee1 2.5inch NAS"
	depends on SOC_MT7621 && DTB_RT_NONE
	select BUILTIN_DTB

config DTB_GNUBEE1_UBOOT
	bool "GnuBee1 2.5inch NAS - with u-boot hacking support"
	depends on SOC_MT7621 && DTB_RT_NONE
	select BUILTIN_DTB

config DTB_GNUBEE2
	bool "GnuBee2 3.5inch NAS"
	depends on SOC_MT7621 && DTB_RT_NONE
	select BUILTIN_DTB

config DTB_HLK7621A
	bool "HLK-7621A"
	depends on SOC_MT7621 && DTB_RT_NONE
	select BUILTIN_DTB

config DTB_HLK7621A_UBOOT
	bool "HLK-7621A - with dual u-boot"
	depends on SOC_MT7621 && DTB_RT_NONE
	select BUILTIN_DTB
```
